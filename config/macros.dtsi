
ctrlc: macro_copy{
compatible = "zmk,behavior-macro";
label = "macro_copy";
#binding-cells = <0>;
bindings = <&macro_press &kp LCTRL>,
           <&macro_tap &kp C>,
           <&macro_release &kp LCTRL>;
};

ctrlv: macro_paste{
compatible = "zmk,behavior-macro";
label = "macro_paste";
#binding-cells = <0>;
bindings = <&macro_press &kp LCTRL>,
           <&macro_tap &kp V>,
           <&macro_release &kp LCTRL>;
};

ctrly: macro_redo{
compatible = "zmk,behavior-macro";
label = "macro_redo";
#binding-cells = <0>;
bindings = <&macro_press &kp LCTRL>,
           <&macro_tap &kp Y>,
           <&macro_release &kp LCTRL>;
};

ctrlz: macro_undo{
compatible = "zmk,behavior-macro";
label = "macro_undo";
#binding-cells = <0>;
bindings = <&macro_press &kp LCTRL>,
           <&macro_tap &kp Z>,
           <&macro_release &kp LCTRL>;
};
